/dts-v1/;

/ {
	compatible = "fdt-splice,self-test";
	#address-cells = <0x01>;
	#size-cells = <0x01>;

	fragment@0 {
		target = <0x01>;

		__overlay__ {
			existing_u32 = <0x99>;
			existing_str = "hello";
			existing_bool;
			new_u32 = <0x1234>;
			new_arr = <0x01 0x02 0x03>;
			new_bool;
			new_str = "world";

			child@0 {
				reg = <0x00>;
				value = <0xaa 0xbb>;
			};

			child@1 {
				reg = <0x01>;
			};

			pps_charge_third_strategy {
				oplus,soc_range = <0x00 0x14 0x23 0x37 0x4b 0x55 0x5a>;
				oplus,temp_range = <0x00 0x32 0x78 0xa0 0xd2 0x15e 0x1fe>;

				strategy_soc_range_min {
					strategy_temp_little_cold = <0x2af8 0x1036 0xbb8 0x00 0x00>;
					strategy_temp_warm = <0x2af8 0x1022 0x73a 0x00 0x00>;
				};

				strategy_soc_range_high {
					strategy_temp_little_cold = <0x2af8 0x1036 0x3e8 0x01 0x00>;
				};
			};
		};
	};
};
