/dts-v1/;

/ {
	pps_charge_third_strategy {
		oplus,soc_range = <0x00 0x14 0x23 0x37 0x4b 0x55 0x5a>;
		oplus,temp_range = <0x00 0x32 0x78 0xa0 0xd2 0x15e 0x1fe>;

		strategy_soc_range_min {
			strategy_temp_little_cold = <0x2af8 0x1036 0x0bb8 0x00 0x00>;
			strategy_temp_warm = <0x2af8 0x1022 0x073a 0x00 0x00>;
		};

		strategy_soc_range_high {
			strategy_temp_little_cold = <0x2af8 0x1036 0x03e8 0x01 0x00>;
		};
	};
};
